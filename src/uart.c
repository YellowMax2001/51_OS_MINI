#include <uart.h>

/*****************************************
 *独立波特率发生器串口初始化
 *例:uart_bart(38400);  初始化串口波特率38400 
 *32M晶振专用
 *****************************************/
void uart_bart(uint baud)
{
	SCON |= 0x50;          //REN置位为1，允许接收，SM1 = 0；SM0 = 1；
	//串口1工作在方式1，八位可变波特率
	AUXR |= 0x05;		   //独立波特率发生器做串口1时钟源
	AUXR |= (1 << 4);      //允许独立波特率发生器运行(开启独立波特率发生器)

	if(baud > 115200)
	{
		BRT = 0xF7;
	}
	else if(baud < 4800)
	{
		BRT = 0x30;
	}
	else
		BRT	  = 256 - (1000000 / baud  + 1);

	EA = 1;	               //开全局中断
//	ES = 1;				   //开总中断
}

/*****************************************
 *独立波特率发生器串口初始化
 *例:uart_bart(38400);  初始化串口波特率38400 
 *11.0592M晶振专用
 *****************************************/
void uart_bart11(uint baud)
{
	SCON |= 0x50;          //REN置位为1，允许接收，SM1 = 0；SM0 = 1；
	//串口1工作在方式1，八位可变波特率
	AUXR |= 0x05;		   //独立波特率发生器做串口1时钟源
	AUXR |= (1 << 4);      //允许独立波特率发生器运行(开启独立波特率发生器)

	if(baud > 38400)
	{
		BRT = 256 - 345600 / 38400 / 2;
	}
	else if(baud < 2400)
	{
		BRT = 256 - 345600 / 2400 / 2;
	}
	else
		BRT	  = 256 - 345600 / baud / 2;

	EA = 1;	               //开全局中断
//	ES = 1;				   //开总中断
}

/*****************************************
 *串口发送一个字节
 *例:uart_send_byte('A');  发送字符A
 *****************************************/
void uart_send_byte(uchar tx_data)
{
	SBUF = tx_data;
	while(!TI);
	TI = 0;
}

/*****************************************
 *串口发送一个字符串
 *例:uart_send_str("www.bohen.com");  发送字符串www.bohen.com
 *****************************************/
void uart_send_str(uchar* str)
{
	while(*str)
	{
		uart_send_byte(*str ++);
	}
}